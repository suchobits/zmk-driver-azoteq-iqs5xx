## drivers/input/Kconfig
```kconfig
menuconfig INPUT_AZOTEQ_IQS5XX
    bool "Azoteq IQS5xx trackpads"
    default y
    depends on GPIO
    depends on I2C
    depends on INPUT
    depends on DT_HAS_AZOTEQ_IQS5XX_ENABLED
    help
      Enable driver for Azoteq IQS5xx trackpads.

if INPUT_AZOTEQ_IQS5XX

config INPUT_AZOTEQ_IQS5XX_INIT_PRIORITY
    int "Azoteq IQS5xx initialization priority"
    default INPUT_INIT_PRIORITY
    help
      Driver initialization priority for the IQS5xx driver.
      Lower values initialize earlier.

config INPUT_AZOTEQ_IQS5XX_POLL_INTERVAL_MS
    int "Polling interval in ms when rdy-gpios is not defined"
    default 10
    help
      When the rdy-gpios pin is not wired (e.g. HolyKeebs modules that
      handle RDY internally), the driver falls back to polling the
      trackpad over I2C at this interval. Lower values are more
      responsive but use more CPU/power. 10ms ≈ 100 Hz.

endif # INPUT_AZOTEQ_IQS5XX
```
